## main/Kconfig.projbuild
```kconfig
menu "ESP32 MQTT Sensor configuration"

config WIFI_SSID
    string "WiFi SSID"
    default ""

config WIFI_PASSWORD
    string "WiFi Password"
    default ""

config MQTT_URI
    string "MQTT Broker URI"
    default "mqtt://192.168.1.100"

config MQTT_USERNAME
    string "MQTT Username"
    default ""

config MQTT_PASSWORD
    string "MQTT Password"
    default ""

config MQTT_TOPIC
    string "MQTT Publish Topic"
    default "esp32_mqtt_sensor"

config REPORT_INTERVAL_S
    int "Reporting interval (seconds)"
    default 1800

config RESTART_INTERVAL_S
    int "Restart interval (seconds)"
    default 600
    help
        If set to a non-zero value, the device will restart itself after this
        many seconds. This can be useful for devices that need to reset
        periodically to avoid memory leaks or other issues.

endmenu

menu "Battery monitoring"

config BAT_ADC_CHANNEL
    int "ADC1 channel (0..7) for battery input (ADC1_CHANNEL_0 = 0)"
    default 0

config BATTERY_DIVIDER_R1
    int "Voltage divider R1 (ohms) -- top resistor"
    default 100000

config BATTERY_DIVIDER_R2
    int "Voltage divider R2 (ohms) -- bottom resistor"
    default 100000

config BATTERY_MIN_MV
    int "Battery voltage (mV) corresponding to 0%"
    default 3000

config BATTERY_MAX_MV
    int "Battery voltage (mV) corresponding to 100%"
    default 4200

endmenu

menu "Distance sensor"

config DISTANCE_ENABLE
    bool "Enable distance sensor support"
    default n

config DISTANCE_MIN_MM
    int "Minimum distance (mm) corresponding to 0%"
    default 50
    depends on DISTANCE_ENABLE

config DISTANCE_MAX_MM
    int "Maximum distance (mm) corresponding to 100%"
    default 2000
    depends on DISTANCE_ENABLE

config VL53L0X_ENABLE
    bool "VL53L0X distance sensor support"
    default y
    depends on DISTANCE_ENABLE
    help
        Internal symbol. Selected by the distance sensor choice when VL53L0X
        is chosen. Do not enable directly.

config VL53L1X_ENABLE
    bool "VL53L1X distance sensor support"
    default y
    depends on DISTANCE_ENABLE
    help
        Internal symbol. Selected by the distance sensor choice when VL53L1X
        is chosen. Do not enable directly.

config TL136_ENABLE
    bool "TL-136 distance sensor support"
    default y
    depends on DISTANCE_ENABLE
    help
        Internal symbol. Selected by the distance sensor choice when TL-136
        is chosen. Do not enable directly.

config TL136_ADC_CHANNEL
    int "ADC1 channel for TL-136 (e.g. 1 for GPIO1)"
    default 1
    depends on TL136_ENABLE
    help
        ADC1 channel number used to read the TL-136 analog output.

config TL136_MAX_DISTANCE_MM
    int "TL-136 maximum distance (mm)"
    default 5000
    depends on TL136_ENABLE
    help
        Maximum distance (in millimetres) used for linear mapping of ADC
        readings to distance output.

config TL136_MIN_DISTANCE_MM
    int "TL-136 minimum distance (mm)"
    default 0
    depends on TL136_ENABLE
    help
        Minimum distance (in millimetres) used for linear mapping of ADC
        readings to distance output.

config TL136_POWER_ON_GPIO
    int "TL-136 power-on GPIO (use 18 for none)"
    default 18
    depends on TL136_ENABLE
    help
        GPIO number used to power on or enable the TL-136 sensor. If 
        set to -1, the driver will not attempt to control a power-on pin.

config TL136_RESISTOR_R1_OHMS
    int "TL-136 voltage divider resistor R1 (ohms)"
    default 100
    depends on TL136_ENABLE
    help        
        Value of resistor R1 in the voltage divider used for the TL-136 sensor
        (the resistor between the sensor output and ADC input).

config TL136_RANGE_MM
    int "TL-136 range (mm)"
    default 5000
    depends on TL136_ENABLE
    help
        Range of the TL-136 sensor in millimetres. This is used to calculate
        the current corresponding to the maximum distance, based on the
        configured voltage divider resistor R1 and the TL-136 current limits.

endmenu

menu "Temperature sensor"

config DS18B20_ENABLE
    bool "DS18B20 1-Wire temperature sensor support"
    default n
    help
        Enable simple DS18B20 driver support. When enabled the driver will
        be built and can be used to read temperature from a single DS18B20
        connected to the configured GPIO.

config DS18B20_GPIO
    int "GPIO for DS18B20 data line"
    default 4
    depends on DS18B20_ENABLE
    help
        GPIO number where the DS18B20 1-Wire data line is connected.
        The driver uses simple bit-banged timing and requires a pull-up
        resistor on the data line (typically 4.7k). Default is GPIO4.

endmenu

menu "Status LED"

config STATUS_LED_GPIO
    int "GPIO for status LED (-1 to disable)"
    default -1
    help
        GPIO number connected to a status LED. Set to -1 to disable LED
        control. Many dev boards use GPIO2 for the on-board LED.

endmenu 

menu "Moisture sensor"

config MOISTURE_ENABLE
    bool "Moisture sensor support"
    default n
    help
        Enable support for an analog moisture sensor connected to an ADC channel.

config MOISTURE_ADC_CHANNEL
    int "ADC1 channel for moisture sensor (0..7)"
    default 0
    depends on MOISTURE_ENABLE
    help
        ADC1 channel number used to read the moisture sensor analog output.

config MOISTURE_POWER_ON_GPIO
    int "GPIO to power moisture sensor (-1 to disable)"
    default -1
    depends on MOISTURE_ENABLE
    help
        GPIO number used to power the moisture sensor. Set to -1 to leave
        the sensor powered permanently or if no power-control pin is used.

endmenu
```

## sdkconfig.defaults
```kconfig
# Project sdkconfig defaults
# Disable VL53L0X sensor by default
CONFIG_VL53L0X_ENABLE=y
```
